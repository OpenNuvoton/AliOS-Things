## app/example/numicro_accelerometer_sensor/Config.in
```kconfig
config AOS_APP_NUMICRO_ACCELEROMETER_SENSOR
    bool "ACCELEROMETER Sensor"
    help
      Get ACCELEROMETER value from a sensor on NuMicro MCU boards

if AOS_APP_NUMICRO_ACCELEROMETER_SENSOR
# Configurations for app
endif
```

## app/example/numicro_aliyun/Config.in
```kconfig
config AOS_APP_NUMICRO_ALIYUN
    bool "NUMICRO ALIYUN"
    select AOS_COMP_NETMGR
    select AOS_COMP_CLI
    select AOS_COMP_CJSON
    select AOS_COMP_LINKKIT_SDK_C
    select APP_FEATURE_LINKKIT_MQTT
    help
        Connect to Aliyun on NuMicro board

if AOS_APP_NUMICRO_ALIYUN
# Configurations for NUMICRO ALIYUN
endif
```

## app/example/numicro_button_led/Config.in
```kconfig
config AOS_APP_NUMICRO_BUTTON_LED
    bool "Test Suite"
    help
      Button and LED controlling on NuMicro boards

if AOS_APP_NUMICRO_BUTTON_LED
# Configurations for app yts
endif
```

## app/example/numicro_temperature_sensor/Config.in
```kconfig
config AOS_APP_NUMICRO_TEMPERATURE_SENSOR
    bool "Temperature Sensor"
    help
      Get Temperature value from a sensor on NuMicro MCU boards

if AOS_APP_NUMICRO_TEMPERATURE_SENSOR
# Configurations for app
endif
```
